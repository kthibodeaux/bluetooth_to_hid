## components/ble_keyboard/Kconfig
```kconfig
menu "BLE keyboard"

    config BLE_KEYBOARD_LOG_REPORTS
        bool "Log every received keyboard report as hex"
        default n
        help
            Logs each 8-byte boot report as it arrives from the keyboard.
            Useful for debugging; noisy in normal use.

endmenu
```

## components/usb_keyboard/Kconfig
```kconfig
menu "USB keyboard"

    config USB_KEYBOARD_MEDIA_KEYS
        bool "Media keys (second HID interface)"
        default y
        help
            Add a Consumer Control HID interface, after the boot keyboard
            interface, so volume, mute and playback keys reach the host.
            The keyboard interface itself is unchanged, so BIOS and KVM
            keyboard emulation still see a plain boot keyboard. Disable if a
            KVM or host refuses composite devices.

endmenu
```

## main/Kconfig.projbuild
```kconfig
menu "Bluetooth to HID bridge"

    config BRIDGE_USB_SELFTEST
        bool "Type a test string over USB at boot"
        default n
        help
            Once the USB host configures the keyboard, wait a few seconds and
            type BRIDGE_USB_SELFTEST_TEXT once. Confirms the host/KVM sees a
            working keyboard without any Bluetooth involved.

    config BRIDGE_USB_SELFTEST_TEXT
        string "Test string"
        depends on BRIDGE_USB_SELFTEST
        default "esp32s3 usb keyboard ok "
        help
            Letters, digits, space and basic punctuation (US layout). No
            Enter is sent, so nothing gets submitted on the host.

    config BRIDGE_USB_SELFTEST_DELAY_MS
        int "Delay after USB is ready before typing (ms)"
        depends on BRIDGE_USB_SELFTEST
        default 5000

endmenu
```
